MEMORY
{
    L1 : ORIGIN = 0x00000000, LENGTH = 512K
}

REGION_ALIAS("REGION_CODE", L1)
REGION_ALIAS("REGION_DATA", L1)
REGION_ALIAS("REGION_RODATA", L1)
REGION_ALIAS("REGION_LDM", L1)

__firmware_start = ORIGIN(L1);
__firmware_stack_size = 1024;

INCLUDE "pkernels-sections.ld"

TENSIX_L1_BASE = 0x0;
TENSIX_LOCAL_DATA_MEM_BASE = 0xFFB00000;
TENSIX_NOCRISC_MEM_BASE = 0xFFC00000;
